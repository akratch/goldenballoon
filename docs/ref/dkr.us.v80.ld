SECTIONS
{
    __romPos = 0;
    header_ROM_START = __romPos;
    header_VRAM = ADDR(.header);
    .header : AT(header_ROM_START) SUBALIGN(16)
    {
        FILL(0x00000000);
        header_DATA_START = .;
        build/asm/header.s.o(.data);
        header_DATA_END = .;
        header_DATA_SIZE = ABSOLUTE(header_DATA_END - header_DATA_START);
    }
    __romPos += SIZEOF(.header);
    header_ROM_END = __romPos;
    header_VRAM_END = .;

    boot_ROM_START = __romPos;
    boot_VRAM = ADDR(.boot);
    .boot : AT(boot_ROM_START) SUBALIGN(16)
    {
        FILL(0x00000000);
        boot_DATA_START = .;
        build/assets/boot.bin.o(.data);
        boot_DATA_END = .;
        boot_DATA_SIZE = ABSOLUTE(boot_DATA_END - boot_DATA_START);
    }
    __romPos += SIZEOF(.boot);
    boot_ROM_END = __romPos;
    boot_VRAM_END = .;

    main_ROM_START = __romPos;
    main_VRAM = ADDR(.main);
    .main 0x80000400 : AT(main_ROM_START) SUBALIGN(16)
    {
        FILL(0x00000000);
        main_TEXT_START = .;
        build/src/hasm/entrypoint.s.o(.text);
        build/src/audio.c.o(.text);
        build/src/audiomgr.c.o(.text);
        build/src/audiosfx.c.o(.text);
        build/src/audio_vehicle.c.o(.text);
        build/src/audio_spatial.c.o(.text);
        build/libultra/src/audio/mips1/seqplayer.c.o(.text);
        build/src/objects.c.o(.text);
        build/src/hasm/obj_shade_fast.s.o(.text);
        build/src/tracks.c.o(.text);
        build/src/hasm/collision.s.o(.text);
        build/src/lights.c.o(.text);
        build/src/object_functions.c.o(.text);
        build/src/racer.c.o(.text);
        build/src/vehicle_tricky.c.o(.text);
        build/src/vehicle_bluey.c.o(.text);
        build/src/vehicle_smokey.c.o(.text);
        build/src/vehicle_bubbler.c.o(.text);
        build/src/vehicle_wizpig.c.o(.text);
        build/src/vehicle_rocket.c.o(.text);
        build/src/object_models.c.o(.text);
        build/src/hasm/obj_animate.s.o(.text);
        build/libultra/src/audio/mips1/csplayer.c.o(.text);
        build/libultra/src/audio/mips1/unknown_064690.c.o(.text);
        build/libultra/src/audio/mips1/seqchannel.c.o(.text);
        build/libultra/src/audio/mips1/cspsetfadein.c.o(.text);
        build/libultra/src/audio/mips1/cspgetfadein.c.o(.text);
        build/libultra/src/audio/mips1/reverb.c.o(.text);
        build/libultra/src/audio/mips1/drvrnew.c.o(.text);
        build/libultra/src/audio/mips1/synthesizer.c.o(.text);
        build/libultra/src/audio/mips1/synallocfx.c.o(.text);
        build/libultra/src/audio/mips1/auxbus.c.o(.text);
        build/libultra/src/audio/mips1/synsetpan.c.o(.text);
        build/libultra/src/audio/mips1/synstartvoiceparam.c.o(.text);
        build/src/main.c.o(.text);
        build/src/camera.c.o(.text);
        build/src/joypad.c.o(.text);
        build/src/game.c.o(.text);
        build/src/thread3_main.c.o(.text);
        build/src/hasm/ido/math_util.s.o(.text);
        build/src/memory.c.o(.text);
        build/libultra/src/io/motor.c.o(.text);
        build/src/save_data.c.o(.text);
        build/src/asset_loading.c.o(.text);
        build/src/borders.c.o(.text);
        build/src/rcp_dkr.c.o(.text);
        build/libultra/src/sc/sched.c.o(.text);
        build/src/set_rsp_segment.c.o(.text);
        build/src/video.c.o(.text);
        build/src/textures_sprites.c.o(.text);
        build/src/screen_asset.c.o(.text);
        build/src/menu.c.o(.text);
        build/src/game_ui.c.o(.text);
        build/src/os_yield_data.c.o(.text);
        build/src/weather.c.o(.text);
        build/src/particles.c.o(.text);
        build/src/unused_string.c.o(.text);
        build/src/printf.c.o(.text);
        build/libultra/src/debug/assert.c.o(.text);
        build/src/thread0_epc.c.o(.text);
        build/src/get_stack_pointer.c.o(.text);
        build/src/waves.c.o(.text);
        build/src/fade_transition.c.o(.text);
        build/src/game_text.c.o(.text);
        build/src/font.c.o(.text);
        build/libultra/src/io/pimgr.c.o(.text);
        build/src/gzip.c.o(.text);
        build/src/hasm/gzip_asm.s.o(.text);
        build/libultra/src/io/leointerrupt.c.o(.text);
        build/src/thread30_bgload.c.o(.text);
        build/libultra/src/audio/heapinit.c.o(.text);
        build/libultra/src/audio/bnkf.c.o(.text);
        build/libultra/src/audio/heapalloc.c.o(.text);
        build/libultra/src/audio/cspsetvol.c.o(.text);
        build/libultra/src/audio/cspgettempo.c.o(.text);
        build/libultra/src/os/getcount.s.o(.text);
        build/libultra/src/audio/cspsetpan.c.o(.text);
        build/libultra/src/audio/cspsetchlvol.c.o(.text);
        build/libultra/src/audio/cspgetchlvol.c.o(.text);
        build/libultra/src/audio/seqpgetfxmix.c.o(.text);
        build/libultra/src/audio/cspsettempo.c.o(.text);
        build/libultra/src/audio/cspgetstate.c.o(.text);
        build/libultra/src/audio/cspsetbank.c.o(.text);
        build/libultra/src/audio/cseq.c.o(.text);
        build/libultra/src/audio/cspsetseq.c.o(.text);
        build/libultra/src/audio/cspplay.c.o(.text);
        build/libultra/src/audio/cspstop.c.o(.text);
        build/libultra/src/io/aisetfreq.c.o(.text);
        build/libultra/src/audio/sl.c.o(.text);
        build/libultra/src/os/createmesgqueue.c.o(.text);
        build/libultra/src/os/createthread.c.o(.text);
        build/libultra/src/os/startthread.c.o(.text);
        build/libultra/src/os/stopthread.c.o(.text);
        build/libultra/src/os/recvmesg.c.o(.text);
        build/libultra/src/os/virtualtophysical.c.o(.text);
        build/libultra/src/io/aisetnextbuf.c.o(.text);
        build/libultra/src/io/aigetlen.c.o(.text);
        build/libultra/src/os/sendmesg.c.o(.text);
        build/libultra/src/io/pidma.c.o(.text);
        build/libultra/src/audio/event.c.o(.text);
        build/libultra/src/audio/synaddplayer.c.o(.text);
        build/libultra/src/audio/synallocvoice.c.o(.text);
        build/libultra/src/audio/synsetvol.c.o(.text);
        build/libultra/src/audio/synstartvoice.c.o(.text);
        build/libultra/src/audio/synsetpitch.c.o(.text);
        build/libultra/src/audio/synsetfxmix.c.o(.text);
        build/libultra/src/audio/synstopvoice.c.o(.text);
        build/libultra/src/audio/synfreevoice.c.o(.text);
        build/libultra/src/audio/cents2ratio.c.o(.text);
        build/libultra/src/os/setintmask.s.o(.text);
        build/libultra/src/gu/sqrtf.s.o(.text);
        build/libultra/src/audio/synsetpriority.c.o(.text);
        . += 0x40;
        build/libultra/src/libc/llcvt.c.o(.text);
        build/libultra/src/libc/rmonPrintf.c.o(.text);
        build/libultra/src/libc/bcopy.s.o(.text);
        build/libultra/src/audio/filter.c.o(.text);
        build/libultra/src/audio/env.c.o(.text);
        build/libultra/src/audio/load.c.o(.text);
        build/libultra/src/audio/resample.c.o(.text);
        build/libultra/src/audio/mainbus.c.o(.text);
        build/libultra/src/audio/save.c.o(.text);
        build/libultra/src/os/initialize.c.o(.text);
        build/libultra/src/os/setthreadpri.c.o(.text);
        build/libultra/src/gu/perspective.c.o(.text);
        build/libultra/src/os/seteventmesg.c.o(.text);
        build/libultra/src/io/controller.c.o(.text);
        build/libultra/src/io/contreaddata.c.o(.text);
        build/libultra/src/io/spsetstat.c.o(.text);
        build/libultra/src/io/dpsetstat.c.o(.text);
        build/libultra/src/os/settime.c.o(.text);
        build/libultra/src/io/pfsisplug.c.o(.text);
        build/libultra/src/io/siacs.c.o(.text);
        build/libultra/src/io/sirawdma.c.o(.text);
        build/libultra/src/io/crc.c.o(.text);
        build/libultra/src/io/contramwrite.c.o(.text);
        build/libultra/src/io/contramread.c.o(.text);
        build/libultra/src/libc/bcmp.s.o(.text);
        build/libultra/src/libc/string.c.o(.text);
        build/libultra/src/io/conteepprobe.c.o(.text);
        build/libultra/src/io/conteepread.c.o(.text);
        build/libultra/src/io/conteepwrite.c.o(.text);
        build/libultra/src/libc/ll.c.o(.text);
        build/libultra/src/io/pfsinit.c.o(.text);
        build/libultra/src/io/pfsreadwritefile.c.o(.text);
        build/libultra/src/io/pfsfreeblocks.c.o(.text);
        build/libultra/src/io/pfschecker.c.o(.text);
        build/libultra/src/io/pfsreformat.c.o(.text);
        build/libultra/src/io/pfsnumfiles.c.o(.text);
        build/libultra/src/libc/bzero.s.o(.text);
        build/libultra/src/io/pfsfilestate.c.o(.text);
        build/libultra/src/io/pfsdeletefile.c.o(.text);
        build/libultra/src/io/pfssearchfile.c.o(.text);
        build/libultra/src/io/pfsallocatefile.c.o(.text);
        build/libultra/src/os/invaldcache.s.o(.text);
        build/libultra/src/os/writebackdcacheall.s.o(.text);
        build/libultra/src/io/dpgetstat.c.o(.text);
        build/libultra/src/io/dpsetnextbuf.c.o(.text);
        build/libultra/src/io/vimgr.c.o(.text);
        build/libultra/src/io/visetmode.c.o(.text);
        build/libultra/src/io/viblack.c.o(.text);
        build/libultra/src/io/visetevent.c.o(.text);
        build/libultra/src/io/sptaskyielded.c.o(.text);
        build/libultra/src/io/vigetcurrframebuf.c.o(.text);
        build/libultra/src/io/vigetnextframebuf.c.o(.text);
        build/libultra/src/io/sptask.c.o(.text);
        build/libultra/src/os/gettime.c.o(.text);
        build/libultra/src/io/sptaskyield.c.o(.text);
        build/libultra/src/io/visetspecial.c.o(.text);
        build/libultra/src/io/viswapbuf.c.o(.text);
        build/libultra/src/os/getactivequeue.c.o(.text);
        build/libultra/src/io/piacs.c.o(.text);
        build/libultra/src/os/getthreadpri.c.o(.text);
        build/libultra/src/os/interrupt.s.o(.text);
        build/libultra/src/io/pirawdma.c.o(.text);
        build/libultra/src/io/epirawdma.c.o(.text);
        build/libultra/src/io/devmgr.c.o(.text);
        build/libultra/src/io/vi.c.o(.text);
        build/libultra/src/audio/syndelete.c.o(.text);
        build/libultra/src/os/thread.c.o(.text);
        build/libultra/src/os/exceptasm.s.o(.text);
        build/libultra/src/os/probetlb.s.o(.text);
        build/libultra/src/io/ai.c.o(.text);
        build/libultra/src/os/jammesg.c.o(.text);
        build/libultra/src/io/pigetcmdq.c.o(.text);
        build/libultra/src/audio/copy.c.o(.text);
        build/libultra/src/libc/xprintf.c.o(.text);
        build/libultra/src/os/setsr.s.o(.text);
        build/libultra/src/os/getsr.s.o(.text);
        build/libultra/src/os/setfpccsr.s.o(.text);
        build/libultra/src/io/sirawread.c.o(.text);
        build/libultra/src/io/sirawwrite.c.o(.text);
        build/libultra/src/os/writebackdcache.s.o(.text);
        build/libultra/src/os/invalicache.s.o(.text);
        build/libultra/src/os/maptlbrdb.s.o(.text);
        build/libultra/src/io/pirawread.c.o(.text);
        build/libultra/src/os/sethwinterrupt.c.o(.text);
        build/libultra/src/gu/mtxutil.c.o(.text);
        build/libultra/src/gu/cosf.c.o(.text);
        build/libultra/src/gu/sinf.c.o(.text);
        build/libultra/src/os/settimer.c.o(.text);
        build/libultra/src/os/timerintr.c.o(.text);
        build/libultra/src/io/si.c.o(.text);
        build/libultra/src/io/contpfs.c.o(.text);
        build/libultra/src/io/dp.c.o(.text);
        build/libultra/src/io/vigetcurrcontext.c.o(.text);
        build/libultra/src/io/viswapcontext.c.o(.text);
        build/libultra/src/io/spgetstat.c.o(.text);
        build/libultra/src/io/spsetpc.c.o(.text);
        build/libultra/src/io/sprawdma.c.o(.text);
        build/libultra/src/io/sp.c.o(.text);
        build/libultra/src/os/resetglobalintmask.c.o(.text);
        build/libultra/src/io/epirawwrite.c.o(.text);
        build/libultra/src/os/yieldthread.c.o(.text);
        build/libultra/src/os/destroythread.c.o(.text);
        build/libultra/src/libc/xlitob.c.o(.text);
        build/libultra/src/libc/xldtob.c.o(.text);
        build/libultra/src/os/setcompare.s.o(.text);
        build/libultra/src/libc/ldiv.c.o(.text);
        build/asm/data/aspMain.s.o(.text);
        build/asm/data/rspboot.s.o(.text);
        build/asm/data/f3ddkr_dram.s.o(.text);
        build/asm/data/f3ddkr_fifo.s.o(.text);
        build/asm/data/f3ddkr_xbus.s.o(.text);
        build/asm/data/ucode_unknown_2.s.o(.text);
        build/libultra/src/gu/libm_vals.s.o(.text);
        . = ALIGN(., 16);
        main_TEXT_END = .;
        main_TEXT_SIZE = ABSOLUTE(main_TEXT_END - main_TEXT_START);
        main_DATA_START = .;
        build/src/audio.c.o(.data);
        build/src/audiomgr.c.o(.data);
        build/src/audiosfx.c.o(.data);
        build/src/audio_vehicle.c.o(.data);
        build/src/audio_spatial.c.o(.data);
        build/libultra/src/audio/mips1/seqplayer.c.o(.data);
        build/src/objects.c.o(.data);
        build/src/hasm/obj_shade_fast.s.o(.data);
        build/src/tracks.c.o(.data);
        build/src/hasm/collision.s.o(.data);
        build/src/lights.c.o(.data);
        build/src/object_functions.c.o(.data);
        build/src/racer.c.o(.data);
        build/src/vehicle_tricky.c.o(.data);
        build/src/vehicle_bluey.c.o(.data);
        build/src/vehicle_smokey.c.o(.data);
        build/src/vehicle_bubbler.c.o(.data);
        build/src/vehicle_wizpig.c.o(.data);
        build/src/vehicle_rocket.c.o(.data);
        build/src/object_models.c.o(.data);
        build/src/hasm/obj_animate.s.o(.data);
        build/libultra/src/audio/mips1/csplayer.c.o(.data);
        build/libultra/src/audio/mips1/unknown_064690.c.o(.data);
        build/libultra/src/audio/mips1/seqchannel.c.o(.data);
        build/libultra/src/audio/mips1/cspsetfadein.c.o(.data);
        build/libultra/src/audio/mips1/cspgetfadein.c.o(.data);
        build/libultra/src/audio/mips1/reverb.c.o(.data);
        build/libultra/src/audio/mips1/drvrnew.c.o(.data);
        build/libultra/src/audio/mips1/synthesizer.c.o(.data);
        build/libultra/src/audio/mips1/synallocfx.c.o(.data);
        build/libultra/src/audio/mips1/auxbus.c.o(.data);
        build/libultra/src/audio/mips1/synsetpan.c.o(.data);
        build/libultra/src/audio/mips1/synstartvoiceparam.c.o(.data);
        build/src/main.c.o(.data);
        build/src/camera.c.o(.data);
        build/src/joypad.c.o(.data);
        build/src/game.c.o(.data);
        build/src/thread3_main.c.o(.data);
        build/src/hasm/ido/math_util.s.o(.data);
        build/src/memory.c.o(.data);
        build/libultra/src/io/motor.c.o(.data);
        build/src/save_data.c.o(.data);
        build/src/asset_loading.c.o(.data);
        build/src/borders.c.o(.data);
        build/src/rcp_dkr.c.o(.data);
        build/libultra/src/sc/sched.c.o(.data);
        build/src/set_rsp_segment.c.o(.data);
        build/src/video.c.o(.data);
        build/src/textures_sprites.c.o(.data);
        build/src/screen_asset.c.o(.data);
        build/src/menu.c.o(.data);
        build/src/game_ui.c.o(.data);
        build/src/os_yield_data.c.o(.data);
        build/src/weather.c.o(.data);
        build/src/particles.c.o(.data);
        build/src/unused_string.c.o(.data);
        build/src/printf.c.o(.data);
        build/libultra/src/debug/assert.c.o(.data);
        build/src/thread0_epc.c.o(.data);
        build/src/get_stack_pointer.c.o(.data);
        build/src/waves.c.o(.data);
        build/src/fade_transition.c.o(.data);
        build/src/game_text.c.o(.data);
        build/src/font.c.o(.data);
        build/libultra/src/io/pimgr.c.o(.data);
        build/src/gzip.c.o(.data);
        build/src/hasm/gzip_asm.s.o(.data);
        build/libultra/src/io/leointerrupt.c.o(.data);
        build/src/thread30_bgload.c.o(.data);
        build/libultra/src/audio/heapinit.c.o(.data);
        build/libultra/src/audio/bnkf.c.o(.data);
        build/libultra/src/audio/heapalloc.c.o(.data);
        build/libultra/src/audio/cspsetvol.c.o(.data);
        build/libultra/src/audio/cspgettempo.c.o(.data);
        build/libultra/src/os/getcount.s.o(.data);
        build/libultra/src/audio/cspsetpan.c.o(.data);
        build/libultra/src/audio/cspsetchlvol.c.o(.data);
        build/libultra/src/audio/cspgetchlvol.c.o(.data);
        build/libultra/src/audio/seqpgetfxmix.c.o(.data);
        build/libultra/src/audio/cspsettempo.c.o(.data);
        build/libultra/src/audio/cspgetstate.c.o(.data);
        build/libultra/src/audio/cspsetbank.c.o(.data);
        build/libultra/src/audio/cseq.c.o(.data);
        build/libultra/src/audio/cspsetseq.c.o(.data);
        build/libultra/src/audio/cspplay.c.o(.data);
        build/libultra/src/audio/cspstop.c.o(.data);
        build/libultra/src/io/aisetfreq.c.o(.data);
        build/libultra/src/audio/sl.c.o(.data);
        build/libultra/src/os/createmesgqueue.c.o(.data);
        build/libultra/src/os/createthread.c.o(.data);
        build/libultra/src/os/startthread.c.o(.data);
        build/libultra/src/os/stopthread.c.o(.data);
        build/libultra/src/os/recvmesg.c.o(.data);
        build/libultra/src/os/virtualtophysical.c.o(.data);
        build/libultra/src/io/aisetnextbuf.c.o(.data);
        build/libultra/src/io/aigetlen.c.o(.data);
        build/libultra/src/os/sendmesg.c.o(.data);
        build/libultra/src/io/pidma.c.o(.data);
        build/libultra/src/audio/event.c.o(.data);
        build/libultra/src/audio/synaddplayer.c.o(.data);
        build/libultra/src/audio/synallocvoice.c.o(.data);
        build/libultra/src/audio/synsetvol.c.o(.data);
        build/libultra/src/audio/synstartvoice.c.o(.data);
        build/libultra/src/audio/synsetpitch.c.o(.data);
        build/libultra/src/audio/synsetfxmix.c.o(.data);
        build/libultra/src/audio/synstopvoice.c.o(.data);
        build/libultra/src/audio/synfreevoice.c.o(.data);
        build/libultra/src/audio/cents2ratio.c.o(.data);
        build/libultra/src/os/setintmask.s.o(.data);
        build/libultra/src/gu/sqrtf.s.o(.data);
        build/libultra/src/audio/synsetpriority.c.o(.data);
        build/libultra/src/libc/llcvt.c.o(.data);
        build/libultra/src/libc/rmonPrintf.c.o(.data);
        build/libultra/src/libc/bcopy.s.o(.data);
        build/libultra/src/audio/filter.c.o(.data);
        build/libultra/src/audio/env.c.o(.data);
        build/libultra/src/audio/load.c.o(.data);
        build/libultra/src/audio/resample.c.o(.data);
        build/libultra/src/audio/mainbus.c.o(.data);
        build/libultra/src/audio/save.c.o(.data);
        build/libultra/src/os/initialize.c.o(.data);
        build/libultra/src/os/setthreadpri.c.o(.data);
        build/libultra/src/gu/perspective.c.o(.data);
        build/libultra/src/os/seteventmesg.c.o(.data);
        build/libultra/src/io/controller.c.o(.data);
        build/libultra/src/io/contreaddata.c.o(.data);
        build/libultra/src/io/spsetstat.c.o(.data);
        build/libultra/src/io/dpsetstat.c.o(.data);
        build/libultra/src/os/settime.c.o(.data);
        build/libultra/src/io/pfsisplug.c.o(.data);
        build/libultra/src/io/siacs.c.o(.data);
        build/libultra/src/io/sirawdma.c.o(.data);
        build/libultra/src/io/crc.c.o(.data);
        build/libultra/src/io/contramwrite.c.o(.data);
        build/libultra/src/io/contramread.c.o(.data);
        build/libultra/src/libc/bcmp.s.o(.data);
        build/libultra/src/libc/string.c.o(.data);
        build/libultra/src/io/conteepprobe.c.o(.data);
        build/libultra/src/io/conteepread.c.o(.data);
        build/libultra/src/io/conteepwrite.c.o(.data);
        build/libultra/src/libc/ll.c.o(.data);
        build/libultra/src/io/pfsinit.c.o(.data);
        build/libultra/src/io/pfsreadwritefile.c.o(.data);
        build/libultra/src/io/pfsfreeblocks.c.o(.data);
        build/libultra/src/io/pfschecker.c.o(.data);
        build/libultra/src/io/pfsreformat.c.o(.data);
        build/libultra/src/io/pfsnumfiles.c.o(.data);
        build/libultra/src/libc/bzero.s.o(.data);
        build/libultra/src/io/pfsfilestate.c.o(.data);
        build/libultra/src/io/pfsdeletefile.c.o(.data);
        build/libultra/src/io/pfssearchfile.c.o(.data);
        build/libultra/src/io/pfsallocatefile.c.o(.data);
        build/libultra/src/os/invaldcache.s.o(.data);
        build/libultra/src/os/writebackdcacheall.s.o(.data);
        build/libultra/src/io/dpgetstat.c.o(.data);
        build/libultra/src/io/dpsetnextbuf.c.o(.data);
        build/libultra/src/io/vimgr.c.o(.data);
        build/libultra/src/io/visetmode.c.o(.data);
        build/libultra/src/io/viblack.c.o(.data);
        build/libultra/src/io/visetevent.c.o(.data);
        build/libultra/src/io/sptaskyielded.c.o(.data);
        build/libultra/src/io/vigetcurrframebuf.c.o(.data);
        build/libultra/src/io/vigetnextframebuf.c.o(.data);
        build/libultra/src/io/sptask.c.o(.data);
        build/libultra/src/os/gettime.c.o(.data);
        build/libultra/src/io/sptaskyield.c.o(.data);
        build/libultra/src/io/visetspecial.c.o(.data);
        build/libultra/src/io/viswapbuf.c.o(.data);
        build/libultra/src/os/getactivequeue.c.o(.data);
        build/libultra/src/io/vitbl.c.o(.data);
        build/libultra/src/io/piacs.c.o(.data);
        build/libultra/src/os/getthreadpri.c.o(.data);
        build/libultra/src/os/interrupt.s.o(.data);
        build/libultra/src/io/pirawdma.c.o(.data);
        build/libultra/src/io/epirawdma.c.o(.data);
        build/libultra/src/io/devmgr.c.o(.data);
        build/libultra/src/io/vi.c.o(.data);
        build/libultra/src/audio/syndelete.c.o(.data);
        build/libultra/src/os/thread.c.o(.data);
        build/libultra/src/os/exceptasm.s.o(.data);
        build/libultra/src/os/probetlb.s.o(.data);
        build/libultra/src/io/ai.c.o(.data);
        build/libultra/src/os/jammesg.c.o(.data);
        build/libultra/src/io/pigetcmdq.c.o(.data);
        build/libultra/src/audio/copy.c.o(.data);
        build/libultra/src/libc/xprintf.c.o(.data);
        build/libultra/src/os/setsr.s.o(.data);
        build/libultra/src/os/getsr.s.o(.data);
        build/libultra/src/os/setfpccsr.s.o(.data);
        build/libultra/src/io/sirawread.c.o(.data);
        build/libultra/src/io/sirawwrite.c.o(.data);
        build/libultra/src/os/writebackdcache.s.o(.data);
        build/libultra/src/os/invalicache.s.o(.data);
        build/libultra/src/os/maptlbrdb.s.o(.data);
        build/libultra/src/io/pirawread.c.o(.data);
        build/libultra/src/os/sethwinterrupt.c.o(.data);
        build/libultra/src/gu/mtxutil.c.o(.data);
        build/libultra/src/gu/cosf.c.o(.data);
        build/libultra/src/gu/sinf.c.o(.data);
        build/libultra/src/os/settimer.c.o(.data);
        build/libultra/src/os/timerintr.c.o(.data);
        build/libultra/src/io/si.c.o(.data);
        build/libultra/src/io/contpfs.c.o(.data);
        build/libultra/src/io/dp.c.o(.data);
        build/libultra/src/io/vigetcurrcontext.c.o(.data);
        build/libultra/src/io/viswapcontext.c.o(.data);
        build/libultra/src/io/spgetstat.c.o(.data);
        build/libultra/src/io/spsetpc.c.o(.data);
        build/libultra/src/io/sprawdma.c.o(.data);
        build/libultra/src/io/sp.c.o(.data);
        build/libultra/src/os/resetglobalintmask.c.o(.data);
        build/libultra/src/io/epirawwrite.c.o(.data);
        build/libultra/src/os/yieldthread.c.o(.data);
        build/libultra/src/os/destroythread.c.o(.data);
        build/libultra/src/libc/xlitob.c.o(.data);
        build/libultra/src/libc/xldtob.c.o(.data);
        build/libultra/src/os/setcompare.s.o(.data);
        build/libultra/src/libc/ldiv.c.o(.data);
        build/src/hasm/entrypoint.s.o(.data);
        build/asm/data/rspboot.s.o(.data);
        build/libultra/src/gu/libm_vals.s.o(.data);
        . = ALIGN(., 16);
        main_DATA_END = .;
        main_DATA_SIZE = ABSOLUTE(main_DATA_END - main_DATA_START);
        main_RODATA_START = .;
        build/src/audio.c.o(.rodata);
        build/src/audiomgr.c.o(.rodata);
        build/src/audiosfx.c.o(.rodata);
        build/src/audio_vehicle.c.o(.rodata);
        build/src/audio_spatial.c.o(.rodata);
        build/libultra/src/audio/mips1/seqplayer.c.o(.rodata);
        build/src/objects.c.o(.rodata);
        build/src/hasm/obj_shade_fast.s.o(.rodata);
        build/src/tracks.c.o(.rodata);
        build/src/hasm/collision.s.o(.rodata);
        build/src/lights.c.o(.rodata);
        build/src/object_functions.c.o(.rodata);
        build/src/racer.c.o(.rodata);
        build/src/vehicle_tricky.c.o(.rodata);
        build/src/vehicle_bluey.c.o(.rodata);
        build/src/vehicle_smokey.c.o(.rodata);
        build/src/vehicle_bubbler.c.o(.rodata);
        build/src/vehicle_wizpig.c.o(.rodata);
        build/src/vehicle_rocket.c.o(.rodata);
        build/src/object_models.c.o(.rodata);
        build/src/hasm/obj_animate.s.o(.rodata);
        build/libultra/src/audio/mips1/csplayer.c.o(.rodata);
        build/libultra/src/audio/mips1/unknown_064690.c.o(.rodata);
        build/libultra/src/audio/mips1/seqchannel.c.o(.rodata);
        build/libultra/src/audio/mips1/cspsetfadein.c.o(.rodata);
        build/libultra/src/audio/mips1/cspgetfadein.c.o(.rodata);
        build/libultra/src/audio/mips1/reverb.c.o(.rodata);
        build/libultra/src/audio/mips1/drvrnew.c.o(.rodata);
        build/libultra/src/audio/mips1/synthesizer.c.o(.rodata);
        build/libultra/src/audio/mips1/synallocfx.c.o(.rodata);
        build/libultra/src/audio/mips1/auxbus.c.o(.rodata);
        build/libultra/src/audio/mips1/synsetpan.c.o(.rodata);
        build/libultra/src/audio/mips1/synstartvoiceparam.c.o(.rodata);
        build/src/main.c.o(.rodata);
        build/src/camera.c.o(.rodata);
        build/src/joypad.c.o(.rodata);
        build/src/game.c.o(.rodata);
        build/src/thread3_main.c.o(.rodata);
        build/src/hasm/ido/math_util.s.o(.rodata);
        build/src/memory.c.o(.rodata);
        build/libultra/src/io/motor.c.o(.rodata);
        build/src/save_data.c.o(.rodata);
        build/src/asset_loading.c.o(.rodata);
        build/src/borders.c.o(.rodata);
        build/src/rcp_dkr.c.o(.rodata);
        build/libultra/src/sc/sched.c.o(.rodata);
        build/src/set_rsp_segment.c.o(.rodata);
        build/src/video.c.o(.rodata);
        build/src/textures_sprites.c.o(.rodata);
        build/src/screen_asset.c.o(.rodata);
        build/src/menu.c.o(.rodata);
        build/src/game_ui.c.o(.rodata);
        build/src/os_yield_data.c.o(.rodata);
        build/src/weather.c.o(.rodata);
        build/src/particles.c.o(.rodata);
        build/src/unused_string.c.o(.rodata);
        build/src/printf.c.o(.rodata);
        build/libultra/src/debug/assert.c.o(.rodata);
        build/src/thread0_epc.c.o(.rodata);
        build/src/get_stack_pointer.c.o(.rodata);
        build/src/waves.c.o(.rodata);
        build/src/fade_transition.c.o(.rodata);
        build/src/game_text.c.o(.rodata);
        build/src/font.c.o(.rodata);
        build/libultra/src/io/pimgr.c.o(.rodata);
        build/src/gzip.c.o(.rodata);
        build/src/hasm/gzip_asm.s.o(.rodata);
        build/libultra/src/io/leointerrupt.c.o(.rodata);
        build/src/thread30_bgload.c.o(.rodata);
        build/libultra/src/audio/heapinit.c.o(.rodata);
        build/libultra/src/audio/bnkf.c.o(.rodata);
        build/libultra/src/audio/heapalloc.c.o(.rodata);
        build/libultra/src/audio/cspsetvol.c.o(.rodata);
        build/libultra/src/audio/cspgettempo.c.o(.rodata);
        build/libultra/src/os/getcount.s.o(.rodata);
        build/libultra/src/audio/cspsetpan.c.o(.rodata);
        build/libultra/src/audio/cspsetchlvol.c.o(.rodata);
        build/libultra/src/audio/cspgetchlvol.c.o(.rodata);
        build/libultra/src/audio/seqpgetfxmix.c.o(.rodata);
        build/libultra/src/audio/cspsettempo.c.o(.rodata);
        build/libultra/src/audio/cspgetstate.c.o(.rodata);
        build/libultra/src/audio/cspsetbank.c.o(.rodata);
        build/libultra/src/audio/cseq.c.o(.rodata);
        build/libultra/src/audio/cspsetseq.c.o(.rodata);
        build/libultra/src/audio/cspplay.c.o(.rodata);
        build/libultra/src/audio/cspstop.c.o(.rodata);
        build/libultra/src/io/aisetfreq.c.o(.rodata);
        build/libultra/src/audio/sl.c.o(.rodata);
        build/libultra/src/os/createmesgqueue.c.o(.rodata);
        build/libultra/src/os/createthread.c.o(.rodata);
        build/libultra/src/os/startthread.c.o(.rodata);
        build/libultra/src/os/stopthread.c.o(.rodata);
        build/libultra/src/os/recvmesg.c.o(.rodata);
        build/libultra/src/os/virtualtophysical.c.o(.rodata);
        build/libultra/src/io/aisetnextbuf.c.o(.rodata);
        build/libultra/src/io/aigetlen.c.o(.rodata);
        build/libultra/src/os/sendmesg.c.o(.rodata);
        build/libultra/src/io/pidma.c.o(.rodata);
        build/libultra/src/audio/event.c.o(.rodata);
        build/libultra/src/audio/synaddplayer.c.o(.rodata);
        build/libultra/src/audio/synallocvoice.c.o(.rodata);
        build/libultra/src/audio/synsetvol.c.o(.rodata);
        build/libultra/src/audio/synstartvoice.c.o(.rodata);
        build/libultra/src/audio/synsetpitch.c.o(.rodata);
        build/libultra/src/audio/synsetfxmix.c.o(.rodata);
        build/libultra/src/audio/synstopvoice.c.o(.rodata);
        build/libultra/src/audio/synfreevoice.c.o(.rodata);
        build/libultra/src/audio/cents2ratio.c.o(.rodata);
        build/libultra/src/os/setintmask.s.o(.rodata);
        build/libultra/src/gu/sqrtf.s.o(.rodata);
        build/libultra/src/audio/synsetpriority.c.o(.rodata);
        build/libultra/src/libc/llcvt.c.o(.rodata);
        build/libultra/src/libc/rmonPrintf.c.o(.rodata);
        build/libultra/src/libc/bcopy.s.o(.rodata);
        build/libultra/src/audio/filter.c.o(.rodata);
        build/libultra/src/audio/env.c.o(.rodata);
        build/libultra/src/audio/load.c.o(.rodata);
        build/libultra/src/audio/resample.c.o(.rodata);
        build/libultra/src/audio/mainbus.c.o(.rodata);
        build/libultra/src/audio/save.c.o(.rodata);
        build/libultra/src/os/initialize.c.o(.rodata);
        build/libultra/src/os/setthreadpri.c.o(.rodata);
        build/libultra/src/gu/perspective.c.o(.rodata);
        build/libultra/src/os/seteventmesg.c.o(.rodata);
        build/libultra/src/io/controller.c.o(.rodata);
        build/libultra/src/io/contreaddata.c.o(.rodata);
        build/libultra/src/io/spsetstat.c.o(.rodata);
        build/libultra/src/io/dpsetstat.c.o(.rodata);
        build/libultra/src/os/settime.c.o(.rodata);
        build/libultra/src/io/pfsisplug.c.o(.rodata);
        build/libultra/src/io/siacs.c.o(.rodata);
        build/libultra/src/io/sirawdma.c.o(.rodata);
        build/libultra/src/io/crc.c.o(.rodata);
        build/libultra/src/io/contramwrite.c.o(.rodata);
        build/libultra/src/io/contramread.c.o(.rodata);
        build/libultra/src/libc/bcmp.s.o(.rodata);
        build/libultra/src/libc/string.c.o(.rodata);
        build/libultra/src/io/conteepprobe.c.o(.rodata);
        build/libultra/src/io/conteepread.c.o(.rodata);
        build/libultra/src/io/conteepwrite.c.o(.rodata);
        build/libultra/src/libc/ll.c.o(.rodata);
        build/libultra/src/io/pfsinit.c.o(.rodata);
        build/libultra/src/io/pfsreadwritefile.c.o(.rodata);
        build/libultra/src/io/pfsfreeblocks.c.o(.rodata);
        build/libultra/src/io/pfschecker.c.o(.rodata);
        build/libultra/src/io/pfsreformat.c.o(.rodata);
        build/libultra/src/io/pfsnumfiles.c.o(.rodata);
        build/libultra/src/libc/bzero.s.o(.rodata);
        build/libultra/src/io/pfsfilestate.c.o(.rodata);
        build/libultra/src/io/pfsdeletefile.c.o(.rodata);
        build/libultra/src/io/pfssearchfile.c.o(.rodata);
        build/libultra/src/io/pfsallocatefile.c.o(.rodata);
        build/libultra/src/os/invaldcache.s.o(.rodata);
        build/libultra/src/os/writebackdcacheall.s.o(.rodata);
        build/libultra/src/io/dpgetstat.c.o(.rodata);
        build/libultra/src/io/dpsetnextbuf.c.o(.rodata);
        build/libultra/src/io/vimgr.c.o(.rodata);
        build/libultra/src/io/visetmode.c.o(.rodata);
        build/libultra/src/io/viblack.c.o(.rodata);
        build/libultra/src/io/visetevent.c.o(.rodata);
        build/libultra/src/io/sptaskyielded.c.o(.rodata);
        build/libultra/src/io/vigetcurrframebuf.c.o(.rodata);
        build/libultra/src/io/vigetnextframebuf.c.o(.rodata);
        build/libultra/src/io/sptask.c.o(.rodata);
        build/libultra/src/os/gettime.c.o(.rodata);
        build/libultra/src/io/sptaskyield.c.o(.rodata);
        build/libultra/src/io/visetspecial.c.o(.rodata);
        build/libultra/src/io/viswapbuf.c.o(.rodata);
        build/libultra/src/os/getactivequeue.c.o(.rodata);
        build/libultra/src/io/piacs.c.o(.rodata);
        build/libultra/src/os/getthreadpri.c.o(.rodata);
        build/libultra/src/os/interrupt.s.o(.rodata);
        build/libultra/src/io/pirawdma.c.o(.rodata);
        build/libultra/src/io/epirawdma.c.o(.rodata);
        build/libultra/src/io/devmgr.c.o(.rodata);
        build/libultra/src/io/vi.c.o(.rodata);
        build/libultra/src/audio/syndelete.c.o(.rodata);
        build/libultra/src/os/thread.c.o(.rodata);
        build/libultra/src/os/exceptasm.s.o(.rodata);
        build/libultra/src/os/probetlb.s.o(.rodata);
        build/libultra/src/io/ai.c.o(.rodata);
        build/libultra/src/os/jammesg.c.o(.rodata);
        build/libultra/src/io/pigetcmdq.c.o(.rodata);
        build/libultra/src/audio/copy.c.o(.rodata);
        build/libultra/src/libc/xprintf.c.o(.rodata);
        build/libultra/src/os/setsr.s.o(.rodata);
        build/libultra/src/os/getsr.s.o(.rodata);
        build/libultra/src/os/setfpccsr.s.o(.rodata);
        build/libultra/src/io/sirawread.c.o(.rodata);
        build/libultra/src/io/sirawwrite.c.o(.rodata);
        build/libultra/src/os/writebackdcache.s.o(.rodata);
        build/libultra/src/os/invalicache.s.o(.rodata);
        build/libultra/src/os/maptlbrdb.s.o(.rodata);
        build/libultra/src/io/pirawread.c.o(.rodata);
        build/libultra/src/os/sethwinterrupt.c.o(.rodata);
        build/libultra/src/gu/mtxutil.c.o(.rodata);
        build/libultra/src/gu/cosf.c.o(.rodata);
        build/libultra/src/gu/sinf.c.o(.rodata);
        build/libultra/src/os/settimer.c.o(.rodata);
        build/libultra/src/os/timerintr.c.o(.rodata);
        build/libultra/src/io/si.c.o(.rodata);
        build/libultra/src/io/contpfs.c.o(.rodata);
        build/libultra/src/io/dp.c.o(.rodata);
        build/libultra/src/io/vigetcurrcontext.c.o(.rodata);
        build/libultra/src/io/viswapcontext.c.o(.rodata);
        build/libultra/src/io/spgetstat.c.o(.rodata);
        build/libultra/src/io/spsetpc.c.o(.rodata);
        build/libultra/src/io/sprawdma.c.o(.rodata);
        build/libultra/src/io/sp.c.o(.rodata);
        build/libultra/src/os/resetglobalintmask.c.o(.rodata);
        build/libultra/src/io/epirawwrite.c.o(.rodata);
        build/libultra/src/os/yieldthread.c.o(.rodata);
        build/libultra/src/os/destroythread.c.o(.rodata);
        build/libultra/src/libc/xlitob.c.o(.rodata);
        build/libultra/src/libc/xldtob.c.o(.rodata);
        build/libultra/src/os/setcompare.s.o(.rodata);
        build/libultra/src/libc/ldiv.c.o(.rodata);
        build/asm/data/aspMain.s.o(.rodata);
        build/asm/data/rspboot.s.o(.rodata);
        build/asm/data/f3ddkr_dram.s.o(.rodata);
        build/asm/data/f3ddkr_fifo.s.o(.rodata);
        build/asm/data/f3ddkr_xbus.s.o(.rodata);
        build/asm/data/ucode_unknown_2.s.o(.rodata);
        build/libultra/src/gu/libm_vals.s.o(.rodata);
        build/asm/data/aspMain.s.o(.data);
        build/asm/data/f3ddkr_dram.s.o(.data);
        build/asm/data/f3ddkr_fifo.s.o(.data);
        build/asm/data/f3ddkr_xbus.s.o(.data);
        build/asm/data/ucode_unknown_2.s.o(.data);
        build/src/hasm/entrypoint.s.o(.rodata);
        . = ALIGN(., 16);
        main_RODATA_END = .;
        main_RODATA_SIZE = ABSOLUTE(main_RODATA_END - main_RODATA_START);
    }
    main_bss_VRAM = ADDR(.main_bss);
    .main_bss (NOLOAD) : SUBALIGN(16)
    {
        FILL(0x00000000);
        main_BSS_START = .;
        build/src/audio.c.o(.bss);
        build/src/audiomgr.c.o(.bss);
        build/src/audiosfx.c.o(.bss);
        build/src/audio_vehicle.c.o(.bss);
        build/src/audio_spatial.c.o(.bss);
        build/libultra/src/audio/mips1/seqplayer.c.o(.bss);
        build/src/objects.c.o(.bss);
        build/src/hasm/obj_shade_fast.s.o(.bss);
        build/src/tracks.c.o(.bss);
        build/src/hasm/collision.s.o(.bss);
        build/src/lights.c.o(.bss);
        build/src/object_functions.c.o(.bss);
        build/src/racer.c.o(.bss);
        build/src/vehicle_tricky.c.o(.bss);
        build/src/vehicle_bluey.c.o(.bss);
        build/src/vehicle_smokey.c.o(.bss);
        build/src/vehicle_bubbler.c.o(.bss);
        build/src/vehicle_wizpig.c.o(.bss);
        build/src/vehicle_rocket.c.o(.bss);
        build/src/object_models.c.o(.bss);
        build/src/hasm/obj_animate.s.o(.bss);
        build/libultra/src/audio/mips1/csplayer.c.o(.bss);
        build/libultra/src/audio/mips1/unknown_064690.c.o(.bss);
        build/libultra/src/audio/mips1/seqchannel.c.o(.bss);
        build/libultra/src/audio/mips1/cspsetfadein.c.o(.bss);
        build/libultra/src/audio/mips1/cspgetfadein.c.o(.bss);
        build/libultra/src/audio/mips1/reverb.c.o(.bss);
        build/libultra/src/audio/mips1/drvrnew.c.o(.bss);
        build/libultra/src/audio/mips1/synthesizer.c.o(.bss);
        build/libultra/src/audio/mips1/synallocfx.c.o(.bss);
        build/libultra/src/audio/mips1/auxbus.c.o(.bss);
        build/libultra/src/audio/mips1/synsetpan.c.o(.bss);
        build/libultra/src/audio/mips1/synstartvoiceparam.c.o(.bss);
        build/src/main.c.o(.bss);
        build/src/hasm/entrypoint.s.o(.bss);
        build/src/camera.c.o(.bss);
        build/src/joypad.c.o(.bss);
        build/src/game.c.o(.bss);
        build/src/thread3_main.c.o(.bss);
        build/src/hasm/ido/math_util.s.o(.bss);
        build/src/memory.c.o(.bss);
        build/libultra/src/io/motor.c.o(.bss);
        build/src/save_data.c.o(.bss);
        build/src/asset_loading.c.o(.bss);
        build/src/borders.c.o(.bss);
        build/src/rcp_dkr.c.o(.bss);
        build/libultra/src/sc/sched.c.o(.bss);
        build/src/set_rsp_segment.c.o(.bss);
        build/src/video.c.o(.bss);
        build/src/textures_sprites.c.o(.bss);
        build/src/screen_asset.c.o(.bss);
        build/src/menu.c.o(.bss);
        build/src/game_ui.c.o(.bss);
        build/src/os_yield_data.c.o(.bss);
        build/src/weather.c.o(.bss);
        build/src/particles.c.o(.bss);
        build/src/unused_string.c.o(.bss);
        build/src/printf.c.o(.bss);
        build/libultra/src/debug/assert.c.o(.bss);
        build/src/thread0_epc.c.o(.bss);
        build/src/get_stack_pointer.c.o(.bss);
        build/src/waves.c.o(.bss);
        build/src/fade_transition.c.o(.bss);
        build/src/game_text.c.o(.bss);
        build/src/font.c.o(.bss);
        build/libultra/src/io/pimgr.c.o(.bss);
        build/src/gzip.c.o(.bss);
        build/src/hasm/gzip_asm.s.o(.bss);
        build/libultra/src/io/leointerrupt.c.o(.bss);
        build/src/thread30_bgload.c.o(.bss);
        build/libultra/src/audio/heapinit.c.o(.bss);
        build/libultra/src/audio/bnkf.c.o(.bss);
        build/libultra/src/audio/heapalloc.c.o(.bss);
        build/libultra/src/audio/cspsetvol.c.o(.bss);
        build/libultra/src/audio/cspgettempo.c.o(.bss);
        build/libultra/src/os/getcount.s.o(.bss);
        build/libultra/src/audio/cspsetpan.c.o(.bss);
        build/libultra/src/audio/cspsetchlvol.c.o(.bss);
        build/libultra/src/audio/cspgetchlvol.c.o(.bss);
        build/libultra/src/audio/seqpgetfxmix.c.o(.bss);
        build/libultra/src/audio/cspsettempo.c.o(.bss);
        build/libultra/src/audio/cspgetstate.c.o(.bss);
        build/libultra/src/audio/cspsetbank.c.o(.bss);
        build/libultra/src/audio/cseq.c.o(.bss);
        build/libultra/src/audio/cspsetseq.c.o(.bss);
        build/libultra/src/audio/cspplay.c.o(.bss);
        build/libultra/src/audio/cspstop.c.o(.bss);
        build/libultra/src/io/aisetfreq.c.o(.bss);
        build/libultra/src/audio/sl.c.o(.bss);
        build/libultra/src/os/createmesgqueue.c.o(.bss);
        build/libultra/src/os/createthread.c.o(.bss);
        build/libultra/src/os/startthread.c.o(.bss);
        build/libultra/src/os/stopthread.c.o(.bss);
        build/libultra/src/os/recvmesg.c.o(.bss);
        build/libultra/src/os/virtualtophysical.c.o(.bss);
        build/libultra/src/io/aisetnextbuf.c.o(.bss);
        build/libultra/src/io/aigetlen.c.o(.bss);
        build/libultra/src/os/sendmesg.c.o(.bss);
        build/libultra/src/io/pidma.c.o(.bss);
        build/libultra/src/audio/event.c.o(.bss);
        build/libultra/src/audio/synaddplayer.c.o(.bss);
        build/libultra/src/audio/synallocvoice.c.o(.bss);
        build/libultra/src/audio/synsetvol.c.o(.bss);
        build/libultra/src/audio/synstartvoice.c.o(.bss);
        build/libultra/src/audio/synsetpitch.c.o(.bss);
        build/libultra/src/audio/synsetfxmix.c.o(.bss);
        build/libultra/src/audio/synstopvoice.c.o(.bss);
        build/libultra/src/audio/synfreevoice.c.o(.bss);
        build/libultra/src/audio/cents2ratio.c.o(.bss);
        build/libultra/src/os/setintmask.s.o(.bss);
        build/libultra/src/gu/sqrtf.s.o(.bss);
        build/libultra/src/audio/synsetpriority.c.o(.bss);
        build/libultra/src/libc/llcvt.c.o(.bss);
        build/libultra/src/libc/rmonPrintf.c.o(.bss);
        build/libultra/src/libc/bcopy.s.o(.bss);
        build/libultra/src/audio/filter.c.o(.bss);
        build/libultra/src/audio/env.c.o(.bss);
        build/libultra/src/audio/load.c.o(.bss);
        build/libultra/src/audio/resample.c.o(.bss);
        build/libultra/src/audio/mainbus.c.o(.bss);
        build/libultra/src/audio/save.c.o(.bss);
        build/libultra/src/os/initialize.c.o(.bss);
        build/libultra/src/os/setthreadpri.c.o(.bss);
        build/libultra/src/gu/perspective.c.o(.bss);
        build/libultra/src/os/seteventmesg.c.o(.bss);
        build/libultra/src/io/controller.c.o(.bss);
        build/libultra/src/io/contreaddata.c.o(.bss);
        build/libultra/src/io/spsetstat.c.o(.bss);
        build/libultra/src/io/dpsetstat.c.o(.bss);
        build/libultra/src/os/settime.c.o(.bss);
        build/libultra/src/io/pfsisplug.c.o(.bss);
        build/libultra/src/io/siacs.c.o(.bss);
        build/libultra/src/io/sirawdma.c.o(.bss);
        build/libultra/src/io/crc.c.o(.bss);
        build/libultra/src/io/contramwrite.c.o(.bss);
        build/libultra/src/io/contramread.c.o(.bss);
        build/libultra/src/libc/bcmp.s.o(.bss);
        build/libultra/src/libc/string.c.o(.bss);
        build/libultra/src/io/conteepprobe.c.o(.bss);
        build/libultra/src/io/conteepread.c.o(.bss);
        build/libultra/src/io/conteepwrite.c.o(.bss);
        build/libultra/src/libc/ll.c.o(.bss);
        build/libultra/src/io/pfsinit.c.o(.bss);
        build/libultra/src/io/pfsreadwritefile.c.o(.bss);
        build/libultra/src/io/pfsfreeblocks.c.o(.bss);
        build/libultra/src/io/pfschecker.c.o(.bss);
        build/libultra/src/io/pfsreformat.c.o(.bss);
        build/libultra/src/io/pfsnumfiles.c.o(.bss);
        build/libultra/src/libc/bzero.s.o(.bss);
        build/libultra/src/io/pfsfilestate.c.o(.bss);
        build/libultra/src/io/pfsdeletefile.c.o(.bss);
        build/libultra/src/io/pfssearchfile.c.o(.bss);
        build/libultra/src/io/pfsallocatefile.c.o(.bss);
        build/libultra/src/os/invaldcache.s.o(.bss);
        build/libultra/src/os/writebackdcacheall.s.o(.bss);
        build/libultra/src/io/dpgetstat.c.o(.bss);
        build/libultra/src/io/dpsetnextbuf.c.o(.bss);
        build/libultra/src/io/vimgr.c.o(.bss);
        build/libultra/src/io/visetmode.c.o(.bss);
        build/libultra/src/io/viblack.c.o(.bss);
        build/libultra/src/io/visetevent.c.o(.bss);
        build/libultra/src/io/sptaskyielded.c.o(.bss);
        build/libultra/src/io/vigetcurrframebuf.c.o(.bss);
        build/libultra/src/io/vigetnextframebuf.c.o(.bss);
        build/libultra/src/io/sptask.c.o(.bss);
        build/libultra/src/os/gettime.c.o(.bss);
        build/libultra/src/io/sptaskyield.c.o(.bss);
        build/libultra/src/io/visetspecial.c.o(.bss);
        build/libultra/src/io/viswapbuf.c.o(.bss);
        build/libultra/src/os/getactivequeue.c.o(.bss);
        build/libultra/src/io/piacs.c.o(.bss);
        build/libultra/src/os/getthreadpri.c.o(.bss);
        build/libultra/src/os/interrupt.s.o(.bss);
        build/libultra/src/io/pirawdma.c.o(.bss);
        build/libultra/src/io/epirawdma.c.o(.bss);
        build/libultra/src/io/devmgr.c.o(.bss);
        build/libultra/src/io/vi.c.o(.bss);
        build/libultra/src/audio/syndelete.c.o(.bss);
        build/libultra/src/os/thread.c.o(.bss);
        build/libultra/src/os/exceptasm.s.o(.bss);
        build/libultra/src/os/probetlb.s.o(.bss);
        build/libultra/src/io/ai.c.o(.bss);
        build/libultra/src/os/jammesg.c.o(.bss);
        build/libultra/src/io/pigetcmdq.c.o(.bss);
        build/libultra/src/audio/copy.c.o(.bss);
        build/libultra/src/libc/xprintf.c.o(.bss);
        build/libultra/src/os/setsr.s.o(.bss);
        build/libultra/src/os/getsr.s.o(.bss);
        build/libultra/src/os/setfpccsr.s.o(.bss);
        build/libultra/src/io/sirawread.c.o(.bss);
        build/libultra/src/io/sirawwrite.c.o(.bss);
        build/libultra/src/os/writebackdcache.s.o(.bss);
        build/libultra/src/os/invalicache.s.o(.bss);
        build/libultra/src/os/maptlbrdb.s.o(.bss);
        build/libultra/src/io/pirawread.c.o(.bss);
        build/libultra/src/os/sethwinterrupt.c.o(.bss);
        build/libultra/src/gu/mtxutil.c.o(.bss);
        build/libultra/src/gu/cosf.c.o(.bss);
        build/libultra/src/gu/sinf.c.o(.bss);
        build/libultra/src/os/settimer.c.o(.bss);
        build/libultra/src/os/timerintr.c.o(.bss);
        build/libultra/src/io/si.c.o(.bss);
        build/libultra/src/io/contpfs.c.o(.bss);
        build/libultra/src/io/dp.c.o(.bss);
        build/libultra/src/io/vigetcurrcontext.c.o(.bss);
        build/libultra/src/io/viswapcontext.c.o(.bss);
        build/libultra/src/io/spgetstat.c.o(.bss);
        build/libultra/src/io/spsetpc.c.o(.bss);
        build/libultra/src/io/sprawdma.c.o(.bss);
        build/libultra/src/io/sp.c.o(.bss);
        build/libultra/src/os/resetglobalintmask.c.o(.bss);
        build/libultra/src/io/epirawwrite.c.o(.bss);
        build/libultra/src/os/yieldthread.c.o(.bss);
        build/libultra/src/os/destroythread.c.o(.bss);
        build/libultra/src/libc/xlitob.c.o(.bss);
        build/libultra/src/libc/xldtob.c.o(.bss);
        build/libultra/src/os/setcompare.s.o(.bss);
        build/libultra/src/libc/ldiv.c.o(.bss);
        build/asm/data/aspMain.s.o(.bss);
        build/asm/data/rspboot.s.o(.bss);
        build/asm/data/f3ddkr_dram.s.o(.bss);
        build/asm/data/f3ddkr_fifo.s.o(.bss);
        build/asm/data/f3ddkr_xbus.s.o(.bss);
        build/asm/data/ucode_unknown_2.s.o(.bss);
        build/libultra/src/gu/libm_vals.s.o(.bss);
        build/libultra/src/debug/kdebugserver.c.o(.bss);
        . = ALIGN(., 16);
        main_BSS_END = .;
        main_BSS_SIZE = ABSOLUTE(main_BSS_END - main_BSS_START);
    }
    __romPos += SIZEOF(.main);
    __romPos = ALIGN(__romPos, 16);
    . = ALIGN(., 16);
    main_ROM_END = __romPos;
    main_VRAM_END = .;

    assets_lut_ROM_START = __romPos;
    assets_lut_VRAM = ADDR(.assets_lut);
    .assets_lut main_VRAM_END : AT(assets_lut_ROM_START) SUBALIGN(16)
    {
        FILL(0x00000000);
        assets_lut_DATA_START = .;
        build/assets/assets.lut.bin.o(.data);
        assets_lut_DATA_END = .;
        assets_lut_DATA_SIZE = ABSOLUTE(assets_lut_DATA_END - assets_lut_DATA_START);
    }
    __romPos += SIZEOF(.assets_lut);
    assets_lut_ROM_END = __romPos;
    assets_lut_VRAM_END = .;

    assets_ROM_START = __romPos;
    assets_VRAM = ADDR(.assets);
    .assets main_VRAM_END : AT(assets_ROM_START) SUBALIGN(16)
    {
        FILL(0x00000000);
        assets_DATA_START = .;
        build/assets/assets.bin.o(.data);
        assets_DATA_END = .;
        assets_DATA_SIZE = ABSOLUTE(assets_DATA_END - assets_DATA_START);
    }
    __romPos += SIZEOF(.assets);
    assets_ROM_END = __romPos;
    assets_VRAM_END = .;

    /DISCARD/ :
    {
        *(*);
    }
}
